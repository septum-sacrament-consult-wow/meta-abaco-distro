## conf/distro/abaco-x11.conf
```bitbake
require includes/abaco.inc
require includes/x11.inc
require includes/systemd.inc
```

## conf/distro/includes/abaco.conf
```bitbake
DISTRO_NAME = "Abaco Linux"

DISTRO_VERSION = "1"
SDK_VERSION := "${DISTRO_VERSION}"

VENDOR = "-abaco"
SDK_VENDOR := "${VENDOR}sdk"

DISTRO_FEATURES_ABACO = "acl alsa argp ext2 largefile usbgadget usbhost wifi xattr nfs zeroconf pci 3g nfc"

DISTRO_FEATURES = "${DISTRO_FEATURES_ABACO} ${DISTRO_FEATURES_LIBC_DEFAULT}"
```

## conf/distro/includes/abaco.inc
```bitbake
DISTRO_NAME = "Abaco Linux"

DISTRO_VERSION = "1"
SDK_VERSION := "${DISTRO_VERSION}"

VENDOR = "-abaco"
SDK_VENDOR := "${VENDOR}sdk"

DISTRO_FEATURES_ABACO = "acl argp ext2 largefile usbgadget usbhost xattr nfs pci"

DISTRO_FEATURES = "${DISTRO_FEATURES_ABACO} ${DISTRO_FEATURES_LIBC_DEFAULT}"
```

## conf/distro/includes/x11.conf
```bitbake
DISTRO_FEATURES_ABACO_X11 = "x11 opengl"
DISTRO_FEATURES += " ${DISTRO_FEATURES_ABACO_X11}"
```

## conf/distro/includes/x11.inc
```bitbake
DISTRO_FEATURES_ABACO_X11 = "x11 opengl keyboard"
DISTRO_FEATURES += " ${DISTRO_FEATURES_ABACO_X11}"
```

## conf/layer.conf
```bitbake
BBPATH .= ":${LAYERDIR}"

# We have recipes-* directories, add to BBFILES
BBFILES += "${LAYERDIR}/recipes-*/*/*.bb \
            ${LAYERDIR}/recipes-*/*/*.bbappend"

BBFILE_COLLECTIONS += "abaco-distro"
BBFILE_PATTERN_abaco-distro := "^${LAYERDIR}/"
BBFILE_PRIORITY_abaco-distro = "6"
```
